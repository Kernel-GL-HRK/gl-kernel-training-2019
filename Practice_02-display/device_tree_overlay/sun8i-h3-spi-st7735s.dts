/dts-v1/;
/plugin/;

/ {
	compatible = "allwinner,sun8i-h3";

	fragment@0 {
		target = <&spi0>;
		__overlay__ {
			st7735s@0 {
				compatible = "st7735s";
				reg = <0x0>;
				spi-max-frequency = <10000000>;
				status = "okay";
			};
		};
	};
};
