// SPDX-License-Identifier: GPL-2.0-or-later
/*
 *  sun8i-h3-fake.dts - Test module
 *
 *  Copyright (C) 2019 Andrey Pahomov <pahomov.and@gmail.com>
 */
/dts-v1/;
/plugin/;

/ {
	compatible = "allwinner,sun8i-h3";

	fragment@0 {
		target-path = "/";
			__overlay__ {
				status = "okay";

				module_fake0@0 {
					compatible = "module_fake0";
					status = "okay";
				};
		};
	};
};
