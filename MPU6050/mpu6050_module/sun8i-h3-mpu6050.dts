// SPDX-License-Identifier: GPL-2.0-or-later
/*
 *  sun8i-h3-fake.dts - Test module
 *
 *  Copyright (C) 2019 Andrey Pahomov <pahomov.and@gmail.com>
 */
/dts-v1/;
/plugin/;

/ {
	compatible = "allwinner,sun8i-h3";

	fragment@0 {
		target-path = "/soc/i2c@1c2ac00";
			__overlay__ {
				status = "okay";

				mpu6050_a@68 {
					compatible = "mpu6050";
					reg = <0x68>;
					status = "okay";
				};
		};
	};
};
