/dts-v1/;
/plugin/;

/ {
	compatible = "allwinner,sun8i-h3";

	fragment@0 {
		target = <&i2c0>;
		__overlay__ {
			#address-cells = <1>;
			#size-cells = <0>;
			status = "okay";
			mpu6050@68 {
				compatible = "mpu6050";
				reg = <0x68>;
				status = "okay";
			};
		};
	};
};
