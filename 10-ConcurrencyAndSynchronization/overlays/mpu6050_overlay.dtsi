/dts-v1/;
/plugin/;

/ {
	compatible = "allwinner,sun8i-h3";

	fragment@0 {
		target = <&i2c0>;
		__overlay__ {
			status = "okay";
			#address-cells = <1>;
			#size-cells = <0>;

			mpu6050@68 {
				compatible = "mpu6050 i2c driver";
				reg = <0x68>;
				update_interval = <100>;
				status = "okay";
			};
		};
	};
};