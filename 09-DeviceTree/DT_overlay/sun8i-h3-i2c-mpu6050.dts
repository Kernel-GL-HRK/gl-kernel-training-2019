/dts-v1/;
/plugin/;

/ {
	compatible = "allwinner,sun8i-h3";

	fragment@0 {
		target = <&i2c0>;
		__overlay__ {
			mpu6050@68 {
				compatible = "mpu6050_test";
				reg = <0x68>;
				status = "okay";
			};
		};
	};
};
