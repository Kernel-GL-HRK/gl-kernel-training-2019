/dts-v1/;
/plugin/;

/ {
	compatible = "allwinner,sun8i-h3";
	
	fragment@0 {
		target-path = "/";
		__overlay__ {
			fake_module@0 {
				compatible = "orangepi-one,fake-module";
				status = "okay"; // okay disabled
			};
		};
	};
};
